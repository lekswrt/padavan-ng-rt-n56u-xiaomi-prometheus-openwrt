## trunk/backports/compat/regmap/Kconfig
```kconfig
# Generic register map support.  There are no user servicable options here,
# this is an API intended to be used by other kernel subsystems.  These
# subsystems should select the appropriate symbols.

menu "REGMAP Config"

config REGMAP
	default y if REGMAP_I2C
	bool

config REGMAP_I2C
	bool "I2C REGMAP Support"

config I2C
	tristate
	default y
	select I2C_MUX
	select I2C_CHARDEV
	select I2C_COMPAT
	select I2C_BOARDINFO
	select I2C_HELPER_AUTO

config I2C_MUX
	bool

config I2C_COMPAT
	bool

config I2C_CHARDEV
	default y
	tristate

config I2C_BOARDINFO
	bool

config I2C_HELPER_AUTO
	bool

endmenu
```

## trunk/linux-3.4.x/drivers/mtd/ralink/Kconfig
```kconfig
menu "Ralink MTD support"

config MTD_RALINK
	bool "Ralink MTD support"
	default y
	depends on MTD

if MTD_RALINK

choice
	prompt "Flash Type"
	default MTD_SPI_RALINK

	config MTD_NOR_RALINK
		bool "NOR Flash"
		depends on (RALINK_RT3052 || RALINK_RT3883)
		select MTD_CFI

	config MTD_SPI_RALINK
		bool "SPI Flash"

	config MTD_NAND_RALINK
		bool "NAND Flash"
		depends on !(RALINK_RT3352 || RALINK_RT5350 || RALINK_MT7621 || RALINK_MT7628)

	config MTD_NAND_MTK
		bool "NAND Flash"
		depends on (RALINK_MT7621)
		select MTD_NAND
		select MTD_NAND_IDS
		select MTD_NAND_ECC
endchoice

config MTD_SPI_FAST_CLOCK
	bool "Use SPI fast clock, up to 50MHz"
	default n
	depends on MTD_SPI_RALINK

choice
	prompt "SPI Read Mode"
	default MTD_SPI_READ_NORM
	depends on MTD_SPI_RALINK

	config MTD_SPI_READ_NORM
		bool "Normal Read, opcode 0x03"
	config MTD_SPI_READ_FAST
		bool "Fast Read, opcode 0x0B"
	config MTD_SPI_READ_DOR
		bool "Fast Read Dual Out, opcode 0x3B"
		depends on RALINK_MT7620
	config MTD_SPI_READ_DIOR
		bool "Fast Read Dual I/O, opcode 0xBB"
		depends on RALINK_MT7620
endchoice

choice
	prompt "Flash Size"
	default RT2880_FLASH_AUTO

	config RT2880_FLASH_4M
		bool "4M"
		depends on (MTD_SPI_RALINK || MTD_NOR_RALINK)
	config RT2880_FLASH_8M
		bool "8M"
		depends on (MTD_SPI_RALINK || MTD_NOR_RALINK)
	config RT2880_FLASH_16M
		bool "16M"
		depends on (MTD_SPI_RALINK || MTD_NOR_RALINK)
	config RT2880_FLASH_32M
		bool "32M"
		depends on MTD_SPI_RALINK
	config RT2880_FLASH_AUTO
		bool "Autodetect Size"
endchoice

if MTD_NOR_RALINK

config RT2880_MTD_PHYSMAP_START
	hex
	default 0xBF000000 if RALINK_RT3052
	default 0x1C000000 if !RALINK_RT3052

config RT2880_MTD_PHYSMAP_LEN
	hex
	default 0x01000000

config RT2880_MTD_PHYSMAP_BUSWIDTH
	int
	default 2

endif

endif

endmenu
```
